## esp/esp_driver/network_adapter/components/at_cmd_stack/Kconfig
```kconfig
menu "AT command stack configuration"

    config TURN_ON_DEEP_DEBUG
        bool "Turn on DEEP_DEBUG"
        default y
        help
            Configure to print deep debug in format "[<Filename>, <Line>] <debug_message>"
            in AT command stack

    config SKIP_VERIFYING_BROKER
        bool "Skip verifying broker"
        default n
        help
            Allow the MQTT service to skip verifying certificate of MQTT brokers

endmenu
```
